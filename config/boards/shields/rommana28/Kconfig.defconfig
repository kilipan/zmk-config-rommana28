## config/boards/shields/rommana28/Kconfig.defconfig
```kconfig
if SHIELD_ROMMANA28_LEFT

    config ZMK_KEYBOARD_NAME
        default "rommana28"

    config ZMK_SPLIT_ROLE_CENTRAL
        default y

endif # LEFT

if SHIELD_ROMMANA28_LEFT || SHIELD_ROMMANA28_RIGHT

    config ZMK_SPLIT
        default y

endif # LEFT RIGHT
```

## config/boards/shields/rommana28/Kconfig.shield
```kconfig
config SHIELD_ROMMANA28_LEFT
    def_bool $(shields_list_contains,rommana28_left)

config SHIELD_ROMMANA28_RIGHT
    def_bool $(shields_list_contains,rommana28_right)
```
