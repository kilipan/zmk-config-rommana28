/*
 * Copyright (c) 2022 GEIST
 *
 * SPDX-License-Identifier: MIT
 */

#include "rommana28.dtsi"

&kscan0 {
	col-gpios
		= <&xiao_d 10 GPIO_ACTIVE_HIGH>
		, <&xiao_d 9 GPIO_ACTIVE_HIGH>
		, <&xiao_d 8 GPIO_ACTIVE_HIGH>
		, <&xiao_d 7 GPIO_ACTIVE_HIGH>
		;
};
